## payloads/libpayload/configs/defconfig
```kconfig
# CONFIG_LP_MULTIBOOT is not set
CONFIG_LP_COREBOOT_VIDEO_CONSOLE=y
CONFIG_LP_USB=y
CONFIG_LP_USB_UHCI=n
CONFIG_LP_USB_OHCI=n
CONFIG_LP_USB_EHCI=y
CONFIG_LP_USB_EHCI_USB_DEBUG=n
CONFIG_LP_USB_XHCI=y
CONFIG_LP_ARCH_X86=y
CONFIG_LP_GPL=y
#CONFIG_LP_HEAP_SIZE=67108864
CONFIG_LP_HEAP_SIZE=268435456
CONFIG_LP_PC_MOUSE=y
CONFIG_LP_CURSOR=y
CONFIG_LP_USB_HID=y
```

## src/northbridge/intel/haswell/Kconfig
```kconfig
##
## This file is part of the coreboot project.
##
## Copyright (C) 2010 Google Inc.
##
## This program is free software; you can redistribute it and/or modify
## it under the terms of the GNU General Public License as published by
## the Free Software Foundation; version 2 of the License.
##
## This program is distributed in the hope that it will be useful,
## but WITHOUT ANY WARRANTY; without even the implied warranty of
## MERCHANTABILITY or FITNESS FOR A PARTICULAR PURPOSE.  See the
## GNU General Public License for more details.
##

config NORTHBRIDGE_INTEL_HASWELL
	bool
	select CPU_INTEL_HASWELL
	select MMCONF_SUPPORT
	select MMCONF_SUPPORT_DEFAULT
	select NORTHBRIDGE_INTEL_COMMON_MRC_CACHE
	select INTEL_DDI
	select INTEL_DP
	select INTEL_GMA_ACPI
	select HAVE_DEBUG_RAM_SETUP

if NORTHBRIDGE_INTEL_HASWELL

config USE_NATIVE_RAMINIT
	bool "Use native raminit"
	default n
	help
	  Select if you want to use coreboot implementation of raminit rather than
	  System Agent/MRC.bin. You should answer Y.


config BOOTBLOCK_NORTHBRIDGE_INIT
	string
	default "northbridge/intel/haswell/bootblock.c"

config VGA_BIOS_ID
	string
	default "8086,0166"

config CACHE_MRC_SIZE_KB
	int
	default 512

config MRC_CACHE_SIZE
	hex
	depends on !CHROMEOS
	default 0x10000

config DCACHE_RAM_BASE
	hex
	default 0xff7c0000

config DCACHE_RAM_SIZE
	hex
	default 0x10000
	help
	  The size of the cache-as-ram region required during bootblock
	  and/or romstage. Note DCACHE_RAM_SIZE and DCACHE_RAM_MRC_VAR_SIZE
	  must add up to a power of 2.

config DCACHE_RAM_MRC_VAR_SIZE
	hex
	default 0x30000
	help
	  The amount of cache-as-ram region required by the reference code.

config DCACHE_RAM_ROMSTAGE_STACK_SIZE
	hex
	default 0x2000
	help
	  The amount of anticipated stack usage from the data cache
	  during pre-ram rom stage execution.

config HAVE_MRC
	bool "Add a System Agent binary"
	depends on !USE_NATIVE_RAMINIT
	help
	  Select this option to add a System Agent binary to
	  the resulting coreboot image.

	  Note: Without this binary coreboot will not work

config MRC_FILE
	string "Intel System Agent path and filename"
	depends on HAVE_MRC
	default "mrc.bin"
	help
	  The path and filename of the file to use as System Agent
	  binary.

config PRE_GRAPHICS_DELAY
	int "Graphics initialization delay in ms"
	default 0
	help
	  On some systems, coreboot boots so fast that connected monitors
	  (mostly TVs) won't be able to wake up fast enough to talk to the
	  VBIOS. On those systems we need to wait for a bit before executing
	  the VBIOS.

endif
```
